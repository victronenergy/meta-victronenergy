## conf/distro/venus.conf
```bitbake
DISTRO = "venus"
DISTRO_NAME = "Victron Energy"
DISTRO_VERSION = "v1.16-2014-11-27/2"
SDK_VENDOR = "-ve"
SDK_VERSION := "${DISTRO_VERSION}"

MAINTAINER = "Jeroen Hofstee <jhofstee@victronenergy.com>"

TARGET_VENDOR = "-ve"

#hostname = "CCGX"

LOCALCONF_VERSION = "1"
LAYER_CONF_VERSION ?= "6"

DISTRO_FEATURES = " \
		usbhost \
		usbgadget \ 
		opengl \
		wifi \
		${DISTRO_FEATURES_LIBC} \
		"

# See backfilling, this gets enabled by default unless unset
DISTRO_FEATURES_BACKFILL_CONSIDERED = "pulseaudio"

SDK_NAME = "${DISTRO}-${TCLIBC}-${SDK_ARCH}-${TARGET_ARCH}"
SDKPATH = "/opt/${DISTRO}/${SDK_VERSION}"

QEMU_TARGETS ?= "arm"

#PREMIRRORS ?=
#MIRRORS =+ ""

# The CONNECTIVITY_CHECK_URI's are used to test whether we can succesfully
# fetch from the network (and warn you if not). To disable the test set
# the variable to be empty.
# Git example url: git://git.yoctoproject.org/yocto-firewall-test;protocol=git;rev=HEAD

CONNECTIVITY_CHECK_URIS ?= ""

SANITY_TESTED_DISTROS ?= " \
            Yocto (Built by Poky 7.0) 1.2 \n \
            Yocto (Built by Poky 8.0) 1.3 \n \
            Poky 7.0 (Yocto Project 1.2 Reference Distro) 1.2 \n \
            Poky 8.0 (Yocto Project 1.3 Reference Distro) 1.3 \n \
            Ubuntu 10.04.4 LTS \n \
            Ubuntu 11.10 \n \
            Ubuntu 12.04 LTS \n \
            Ubuntu 12.04.1 LTS \n \
            Ubuntu 12.04.3 LTS \n \
            Ubuntu 12.10 \n \
            Ubuntu 14.04.1 LTS \n \
            Fedora release 16 (Verne) \n \
            Fedora release 17 (Beefy Miracle) \n \
            Fedora release 18 (Spherical Cow) \n \
            CentOS release 5.6 (Final) \n \
            CentOS release 5.7 (Final) \n \
            CentOS release 5.8 (Final) \n \
            CentOS release 6.3 (Final) \n \
            Debian GNU/Linux 6.0.6 (squeeze) \n \
            openSUSE 11.4 \n \
            openSUSE 12.1 \n \
            openSUSE 12.2 \n \
	    "

# Default hash policy for distro
BB_SIGNATURE_HANDLER ?= 'OEBasicHash'

# OELAYOUT_ABI allows us to notify users when the format of TMPDIR changes in 
# an incompatible way. Such changes should usually be detailed in the commit
# that breaks the format and have been previously discussed on the mailing list 
# with general agreement from the core team.
#
OELAYOUT_ABI = "8"

#WARN_QA = "unsafe-references-in-binaries unsafe-references-in-scripts"
WARN_QA = ""
ERROR_QA = "dev-so debug-deps dev-deps debug-files arch la2 pkgconfig la perms useless-rpaths rpaths staticdev ldflags"
```

## conf/layer.conf
```bitbake
# add conf and classes directory to BBPATH
BBPATH := "${BBPATH}:${LAYERDIR}"

# add the recipes to BBFILES
BBFILES := "${BBFILES} \
	${LAYERDIR}/recipes-*/*.bb \
	${LAYERDIR}/recipes-*/*/*.bb \
	${LAYERDIR}/recipes-*/*/*/*.bb \
	${LAYERDIR}/backports/recipes-*/*.bb \
	${LAYERDIR}/backports/recipes-*/*/*.bb \
"

BBFILE_COLLECTIONS += "victronenergy"
BBFILE_PATTERN_victronenergy := "^${LAYERDIR}/"
BBFILE_PRIORITY_victronenergy = "7"
```

## conf/machine/achilles.conf
```bitbake
DEFAULTTUNE ?= "cortexa9hf-neon"

#require conf/machine/include/imx-base.inc
require conf/machine/include/tune-cortexa9.inc

# variable needed for compilation
MACHINE_FEATURES ?= "ext2 keyboard screen serial usbhost"

SERIAL_CONSOLE = "115200 ttymxc0"

PREFERRED_PROVIDER_virtual/bootloader = "u-boot-achilles"
PREFERRED_PROVIDER_virtual/kernel ?= "linux-dummy"
PREFERRED_PROVIDER_jpeg = "jpeg"

USE_VT = "1"
```

## meta-alternatives/conf/layer.conf
```bitbake
BBPATH := "${BBPATH}:${LAYERDIR}"

BBFILES := "${BBFILES} \
	${LAYERDIR}/recipes-*/*/*.bb \
	${LAYERDIR}/recipes-*/*/*.bbappend \
"

BBFILE_COLLECTIONS += "victronenergy-alternatives"
BBFILE_PATTERN_victronenergy-alternatives := "^${LAYERDIR}/"
BBFILE_PRIORITY_victronenergy-alternatives = "10"
LAYERSERIES_COMPAT_victronenergy-alternatives = "rocko thud zeus"
```

## meta-backports/conf/layer.conf
```bitbake
BBPATH := "${BBPATH}:${LAYERDIR}"

BBFILES := "${BBFILES} \
	${LAYERDIR}/recipes-*/*/*.bb \
"

BBFILE_COLLECTIONS += "victronenergy-backports"
BBFILE_PATTERN_victronenergy-backports := "^${LAYERDIR}/"
BBFILE_PRIORITY_victronenergy-backports = "0"
```

## meta-bsp/conf/layer.conf
```bitbake
BBPATH := "${BBPATH}:${LAYERDIR}"

BBFILES := "${BBFILES} \
	${LAYERDIR}/recipes-*/*.bb \
	${LAYERDIR}/recipes-*/*/*.bb \
	${LAYERDIR}/recipes-*/*/*/*.bb \
"

BBFILE_COLLECTIONS += "victronenergy-bsp"
BBFILE_PATTERN_victronenergy-bsp := "^${LAYERDIR}/"
BBFILE_PRIORITY_victronenergy-bsp = "5"
LAYERSERIES_COMPAT_victronenergy-bsp = "rocko thud"
```

## meta-bsp/conf/machine/achilles.conf
```bitbake
#DEFAULTTUNE ?= "cortexa9hf-neon"
#require conf/machine/include/imx-base.inc
#require conf/machine/include/tune-cortexa9.inc

# downgrade achilles a bit so it is like the ccgx/beaglebone
DEFAULTTUNE ?= "cortexa8hf-neon"
require conf/machine/include/tune-cortexa8.inc

# variable needed for compilation
MACHINE_FEATURES ?= "ext2 keyboard screen serial usbhost"

SERIAL_CONSOLE = "115200 ttymxc0"

PREFERRED_PROVIDER_virtual/bootloader = "u-boot-achilles"
PREFERRED_PROVIDER_virtual/kernel ?= "linux-dummy"

USE_VT = "1"
```

## meta-bsp/conf/machine/am62xx-k3r5.conf
```bitbake
SOC_FAMILY = "k3r5"

require conf/machine/include/soc-family.inc
require conf/machine/include/arm/armv7r/tune-cortexr5.inc

UBOOT_MACHINE = "am62x_victron_r5_config"
UBOOT_IMAGE = "tiboot3.bin"

NO_RECOMMENDATIONS = "1"
```

## meta-bsp/conf/machine/am62xx.conf
```bitbake
SOC_FAMILY = "k3"

require conf/machine/include/soc-family.inc
require conf/machine/include/arm/armv8a/tune-cortexa53.inc

BBMULTICONFIG += "k3r5"

MACHINE_FEATURES = "usbhost vfat rtc serial wifi"

# start-gui can switch between gui-v1 and gui-v2
START_GUI = "start-gui"

PREFERRED_PROVIDER_virtual/kernel = "linux-venus"
PREFERRED_PROVIDER_virtual/bootloader = "u-boot-k3"
PREFERRED_VERSION_u-boot-fw-utils = "2025.01-k3%"

IMAGE_FSTYPES = "ext4.gz"
ROOT_FSTYPE = "ext4.gz"

FSTAB = "mmc0"

UBOOT_MACHINE = "am62x_victron_a53_config"
UBOOT_IMAGE = "u-boot.img"
SPL_BINARY = "tispl.bin"

KERNEL_CONFIG = "k3_victron_defconfig"
KERNEL_IMAGETYPE = "Image"
KERNEL_DEVICETREE = "\
    ti/k3-am625-cerbo-b10.dtb \
    ti/k3-am625-cerbo-b11.dtb \
"
KERNEL_PACKAGES = "kernel-image kernel-modules"

BOARD_IDS = "\
    cerbogx_b10:VCBA \
    cerbogx_b11:VCBB \
"

IMAGE_BOOT_FILES = "tiboot3.bin ${SPL_BINARY} ${UBOOT_IMAGE}"
SWU_EXTRA_IMAGES = "${IMAGE_BOOT_FILES}"

INITTAB = "S0:12345:respawn:/sbin/getty -L -l /sbin/autologin -n 115200 ttyS0 vt102"
USE_VT = "0"

VENUS_WLAN_AP = "1"
```

## meta-bsp/conf/machine/beaglebone.conf
```bitbake
#@TYPE: Machine
#@NAME: Beaglebone
#@DESCRIPTION: Machine configuration for the Beaglebone

SOC_FAMILY = "ti33x"

DEFAULTTUNE ?= "cortexa8hf-neon"

require conf/machine/include/soc-family.inc
require conf/machine/include/arm/armv7a/tune-cortexa8.inc

MACHINE_FEATURES = "ext2 serial usbhost vfat"

# Inputs for machine-conf-runtime recipe
MACHINE_FEATURES += "headless"
VE_PWM_BUZZER = "400"

PREFERRED_PROVIDER_virtual/kernel = "linux-venus"
PREFERRED_PROVIDER_virtual/bootloader = "u-boot-bbb"
PREFERRED_VERSION_u-boot-fw-utils = "2015.07-bbb%"

SWU_VERSION = "2"

IMAGE_FSTYPES = "ext4.gz tar.gz"

FSTAB = "mmc1"

UBOOT_ENTRYPOINT = "0x80008000"
UBOOT_LOADADDRESS = "0x80008000"
UBOOT_MACHINE = "am335x_boneblack_config"
UBOOT_IMAGE = "u-boot.img"
SPL_BINARY = "MLO"

KERNEL_CONFIG = "bbb_defconfig"
KERNEL_IMAGETYPE = "zImage"
KERNEL_DEVICETREE = "\
    ti/omap/am335x-boneblack.dtb \
    ti/omap/bbb-venus.dtb \
    ti/omap/bbb-octo-venus.dtb \
    ti/omap/bbe-venus.dtb \
    ti/omap/bbe-smscphy-venus.dtb \
    ti/omap/bbe-smscphy-nopmic-venus.dtb \
"
KERNEL_PACKAGES = "kernel-image kernel-modules"

# Used by wic
IMAGE_BOOT_FILES ?= "${UBOOT_IMAGE} MLO uEnv.txt"

INITTAB = "O0:12345:respawn:/sbin/getty -L -l /sbin/autologin -n 115200 ttyO0 vt102"
USE_VT = "0"
```

## meta-bsp/conf/machine/canvu500.conf
```bitbake
#@TYPE: Machine
#@NAME: CANvu 500
#@DESCRIPTION: Machine configuration for the CANvu 500

SOC_FAMILY = "imx6"

DEFAULTTUNE ?= "cortexa9hf-neon"

require conf/machine/include/soc-family.inc
require conf/machine/include/tune-cortexa9.inc

MACHINE_FEATURES = "screen serial usbhost"

PACKAGECONFIG_append_pn-mesa += "etnaviv kmsro"
PACKAGECONFIG_append_pn-qtbase += " gbm"

# Inputs for machine-conf-runtime recipe
VE_CAN_PORTS = "can0 can1"
VE_BLANK_DISPLAY = "/sys/class/backlight/backlight/bl_power"
VE_BACKLIGHT = "/sys/class/backlight/backlight"
VE_PWM_BUZZER = "400"

PREFERRED_PROVIDER_virtual/kernel = "linux-canvu500"
PREFERRED_PROVIDER_virtual/bootloader = "u-boot-canvu500"
PREFERRED_VERSION_u-boot-fw-utils = "2017.09-canvu500%"

SWU_VERSION = "2"

IMAGE_FSTYPES = "ubifs tar.gz"

FSTAB = "ubi"

UBOOT_ENTRYPOINT = "0x80008000"
UBOOT_LOADADDRESS = "0x80008000"
UBOOT_MACHINE = "canvu500_config"
UBOOT_SUFFIX = "imx"

KERNEL_CLASSES = "kernel-fitimage"
KERNEL_DEVICETREE = "imx6sx-canvu500.dtb"
KERNEL_IMAGETYPE = "fitImage"
KERNEL_PACKAGES = "kernel-image kernel-modules"

# UBI image
UBI_VOLNAME = "rootfs"
MKUBIFS_ARGS = "-m 4096 -e 253952 -c 1024"
UBINIZE_ARGS = "-m 4096 -p 256KiB"

SERIAL_CONSOLES = "-l;/sbin/autologin;-n;115200;ttymxc0"
USE_VT = "0"
```

## meta-bsp/conf/machine/ccgx-common.inc
```bitbake
# variable needed for compilation
MACHINE_FEATURES ?= "ext2 keyboard screen serial usbgadget usbhost"

# Inputs for machine-conf-runtime recipe
VE_MKX_PORT = "/dev/ttyO1"
VE_VEDIRECT_PORTS = "/dev/ttyO2"
VE_VEDIRECT_AND_CONSOLE_PORT = "/dev/ttyO0"
VE_RELAYS = "/sys/class/gpio/gpio182"
VE_BUZZER = "/sys/class/gpio/gpio35"

PREFERRED_PROVIDER_virtual/kernel ?= "linux-ccgx"
PREFERRED_PROVIDER_virtual/bootloader = "u-boot-ccgx"
PREFERRED_VERSION_u-boot-fw-utils = "2013.01.01-ccgx-v3"

# config of u-boot to be used
UBOOT_MACHINE = "bpp3_config"
UBOOT_ENTRYPOINT = "0x80008000"
UBOOT_LOADADDRESS = "0x80008000"

# generate uImage variant of linux kernel
KERNEL_IMAGETYPE = "uImage"

# UBI image
UBI_VOLNAME="rootfs"
MKUBIFS_ARGS = "-m 2048 -e 129024 -c 2388"
UBINIZE_ARGS = "-m 2048 -p 128KiB -s 512 -O 512"
```

## meta-bsp/conf/machine/ccgx.conf
```bitbake
#@TYPE: Machine
#@NAME: Color Control GX (with swupdate, hardfloat)
#@DESCRIPTION: Machine configuration file

# ccgx binary compatible with the beaglebone
DEFAULTTUNE = "cortexa8hf-neon"

require conf/machine/include/tune-cortexa8.inc

# variable needed for compilation
MACHINE_FEATURES ?= "ext2 keyboard screen serial usbgadget usbhost"

# Inputs for machine-conf-runtime recipe
VE_BUZZER = "/sys/class/gpio/gpio35"
VE_BLANK_DISPLAY = "/sys/class/backlight/backlight/bl_power"
VE_BACKLIGHT = "/sys/class/backlight/backlight"
VE_LARGE_IMAGE_SUPPORT = "0"

PREFERRED_PROVIDER_virtual/kernel ?= "linux-ccgx"
PREFERRED_PROVIDER_virtual/bootloader = "u-boot-ccgx"
PREFERRED_VERSION_u-boot-fw-utils = "2013.01.01-ccgx%"

# config of u-boot to be used
UBOOT_MACHINE = "bpp3_config"
UBOOT_ENTRYPOINT = "0x80008000"
UBOOT_LOADADDRESS = "0x80008000"
UBOOT_IMAGE = "u-boot.img"
SPL_BINARY = "MLO"

# generate uImage variant of linux kernel
KERNEL_IMAGETYPE = "uImage"
KERNEL_PACKAGES = "kernel-modules"
# Note: the dtb is actually appended to the linux image, but swupdate
# checks the dtb for hardware-compatibility.
KERNEL_DEVICETREE = "am3517-ccgx.dtb"

# UBI image
UBI_VOLNAME="rootfs"
MKUBIFS_ARGS = "-m 2048 -e 129024 -c 2388"
UBINIZE_ARGS = "-m 2048 -p 128KiB -s 512 -O 512"

IMAGE_CLASSES = "image_types_ve"

# as minimum ubifs format of rootfs is required to program nand memory
IMAGE_FSTYPES += "tar.gz ext3 ubifs live-img.gz"

FSTAB = "ubi"

# parameters for sysvinit inittab, disabled on purpose, used for ve.direct
#SERIAL_CONSOLES = "-l /sbin/autologin -n 115200 ttyO0"

# Enable use of virtual terminal for LCD on tty1 if USE_VT = "1"
USE_VT = "0"
```

## meta-bsp/conf/machine/ccgxhf.conf
```bitbake
#@TYPE: Machine
#@NAME: Color Control GX (with swupdate, hardfloat)
#@DESCRIPTION: Machine configuration file

# ccgx binary compatible with the beaglebone
DEFAULTTUNE = "cortexa8hf-neon"

require conf/machine/include/tune-cortexa8.inc
require ccgx-common.inc

IMAGE_CLASSES = "image_types_ve"

# as minimum ubifs format of rootfs is required to program nand memory
IMAGE_FSTYPES += "tar.gz ext3 ubifs live.img.gz"

# parameters for sysvinit inittab, disabled on purpose, used for ve.direct
#SERIAL_CONSOLE = "115200 ttyO0"

# Enable use of virtual terminal for LCD on tty1 if USE_VT = "1"
USE_VT = "0"
```

## meta-bsp/conf/machine/cerbosgx.conf
```bitbake
# The Cerbo-S GX is compatible with newer einstein images, but the older images will
# fail to boot. Hence a seperate image is made for the Cerbo S, so older images cannot
# be installed.

require einstein.conf
MACHINEOVERRIDES =. "einstein:"
```

## meta-bsp/conf/machine/dummy-cortexa8hf.conf
```bitbake
# dummy build to make sstate for beaglebone, ccgx etc
DEFAULTTUNE = "cortexa8hf-neon"

require conf/machine/include/tune-cortexa8.inc
PREFERRED_PROVIDER_virtual/kernel ?= "linux-dummy"
PREFERRED_PROVIDER_kernel-base ?= "linux-dummy"
PREFERRED_PROVIDER_kernel-image ?= "linux-dummy"

DISTRO_FEATURES_append = " opengl"
PACKAGECONFIG_append_pn-qtbase = " gles2 linuxfb"

# variable needed for compilation
MACHINE_FEATURES ?= "ext2 keyboard screen serial usbgadget usbhost"
```

## meta-bsp/conf/machine/einstein.conf
```bitbake
#@TYPE: Machine
#@NAME: Einstein A20
#@DESCRIPTION: Cubietech Einstein A20 SOM

include sunxi.conf

UBOOT_MACHINE = "einstein_victron_defconfig"

# start-gui can switch between gui-v1 and gui-v2
START_GUI = "start-gui"

KERNEL_DEVICETREE = "\
    allwinner/sun7i-a20-einstein-ccgx2.dtb \
    allwinner/sun7i-a20-einstein-cerbo-b1.dtb \
    allwinner/sun7i-a20-einstein-cerbo-gx-s.dtb \
"

BOARD_IDS = "\
    cerbogx:VECB \
    cerbogx_b1:VCB1 \
"
```

## meta-bsp/conf/machine/ekrano.conf
```bitbake
# The Ekrano is compatible with newer nanopi images, but the older images will
# fail to boot. Hence a seperate image is made for the Ekrano, so older images
# cannot be installed.

require nanopi.conf
MACHINEOVERRIDES =. "nanopi:"

KERNEL_DEVICETREE = " \
    allwinner/sun8i-h3-sinh3-ekrano.dtb \
"

BOARD_IDS = "\
    ekrano:VEKR \
"
```
