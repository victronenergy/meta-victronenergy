## meta-bsp/conf/machine/include/rpi-base.inc
```bitbake
SOC_FAMILY = "rpi"
include conf/machine/include/soc-family.inc

WKS_FILE ?= "sdimage-raspberrypi.wks"

# Inputs for machine-conf-runtime recipe
MACHINE_FEATURES += "headless"

PREFERRED_PROVIDER_virtual/kernel ?= "linux-raspberrypi"

RPI_KERNEL_DEVICETREE_OVERLAYS = " \
    overlays/ads7846.dtbo \
    overlays/disable-bt.dtbo \
    overlays/disable-wifi.dtbo \
    overlays/gpio-fan.dtbo \
    overlays/pitft28-capacitive.dtbo \
    overlays/pitft35-resistive.dtbo \
    overlays/rpi-display.dtbo \
    overlays/mcp2515-can0.dtbo \
    overlays/mcp2515-can1.dtbo \
    overlays/mcp251xfd.dtbo \
    overlays/rpi-backlight.dtbo \
    overlays/rpi-ft5406.dtbo \
    overlays/sc16is752-spi1.dtbo \
    overlays/spi1-3cs.dtbo \
    overlays/waveshare-can-fd-hat-mode-a.dtbo \
    overlays/waveshare-can-fd-hat-mode-b.dtbo \
"

KERNEL_PACKAGES ?= "kernel-image kernel-modules"
KERNEL_IMAGETYPE ?= "zImage"
RPI_KERNEL_DEVICETREE ?= " \
    ${RPI_KERNEL_DEVICETREE_DTB} \
    ${RPI_KERNEL_DEVICETREE_OVERLAYS} \
"

# swupdate uses this to figure out which boards are compatible
KERNEL_DEVICETREE = "${RPI_KERNEL_DEVICETREE_DTB}"

PREFERRED_PROVIDER_virtual/bootloader ?= "u-boot-venus"
PREFERRED_VERSION_u-boot-fw-utils ?= "venus"
UBOOT_SRC_URI ?= "git://github.com/victronenergy/u-boot.git;branch=rpi_v2022.01;tag=37cacbb7c8ecf8f620d75d957ad3640862f5bfd3;protocol=https"
UBOOT_SUFFIX ?= "bin"
UBOOT_BINARY ?= "u-boot.${UBOOT_SUFFIX}"

IMAGE_FSTYPES ?= "wic ext4.gz"

MACHINE_FEATURES += "apm usbhost keyboard vfat ext2 screen touchscreen alsa bluetooth wifi sdio ${@bb.utils.contains('DISABLE_VC4GRAPHICS', '1', '', 'vc4graphics', d)}"

# Raspberry Pi has no hardware clock
MACHINE_FEATURES_BACKFILL_CONSIDERED = "rtc"

SWU_VERSION = "3"

IMAGE_BOOT_FILES ?= " \
    bcm2835-bootfiles/* \
    config.txt \
    cmdline.txt \
    ${RPI_KERNEL_DEVICETREE} \
    ${UBOOT_BINARY} \
"

do_image_wic[depends] += " \
    bcm2835-bootfiles:do_deploy \
    virtual/bootloader:do_deploy \
"

do_image_wic[recrdeps] = "do_deploy"
```

## meta-bsp/conf/machine/include/rpi-legacy.inc
```bitbake
PREFERRED_VERSION_bcm2835-bootfiles = "20220331%"
PREFERRED_VERSION_linux-raspberrypi = "5.10%"
PREFERRED_VERSION_linux-firmware-rpidistro = "20210315%"
```

## meta-bsp/conf/machine/nanopi.conf
```bitbake
#@TYPE: Machine
#@NAME: NanoPi Duo
#@DESCRIPTION: FriendlyARM NanoPi board

include sunxi.conf

UBOOT_MACHINE = "nanopi_victron_defconfig"

KERNEL_DEVICETREE = "\
    allwinner/sun8i-h3-nanopi-easysolar.dtb \
    allwinner/sun8i-h3-nanopi-easysolar-a9.dtb \
    allwinner/sun8i-h3-nanopi-easysolar-a10.dtb \
    allwinner/sun8i-h3-nanopi-maxi-gx.dtb \
    allwinner/sun8i-h3-nanopi-maxi-gx-a9.dtb \
    allwinner/sun8i-h3-nanopi-maxi-gx-a10.dtb \
    allwinner/sun8i-h3-nanopi-paygo.dtb \
    allwinner/sun8i-h3-nanopi-v4-smart-hub.dtb \
    allwinner/sun8i-h3-sinh3-ekrano.dtb \
"

BOARD_IDS = "\
    easysolar:VEES \
    easysolar_a9:VES9 \
    easysolar_a10:VESA \
    maxigx:VEMX \
    maxigx_a10:VMXA \
    multiplus2:VEMP \
    multiplus2_a10:VMPA \
    paygo:VEPG \
"
```

## meta-bsp/conf/machine/raspberrypi4.conf
```bitbake
#@TYPE: Machine
#@NAME: RaspberryPi 4 Development Board (32bit)
#@DESCRIPTION: Machine configuration for the RaspberryPi 4 in 32 bit mode

DEFAULTTUNE ?= "cortexa7hf-neon-vfpv4"
require conf/machine/include/arm/armv7a/tune-cortexa7.inc
require conf/machine/include/rpi-base.inc

KERNEL_CONFIG = "bcm2711_defconfig"

RPI_KERNEL_DEVICETREE_DTB = "broadcom/bcm2711-rpi-4-b.dtb"

UBOOT_MACHINE = "rpi_4_32b_config"

INITTAB = " \
	S0:12345:respawn:/sbin/getty -L -l /sbin/autologin -n 115200 ttyS0 vt102 | \
	1:12345:respawn:/sbin/getty -L -l /sbin/autologin -n 38400 tty1 vt102 \
"

START_GUI="start-gui"
```

## meta-bsp/conf/machine/raspberrypi5.conf
```bitbake
#@TYPE: Machine
#@NAME: RaspberryPi 5 Development Board (64bit)
#@DESCRIPTION: Machine configuration for the RaspberryPi 5 in 64 bits mode

require conf/machine/include/arm/armv8-2a/tune-cortexa76.inc
include conf/machine/include/rpi-base.inc

KERNEL_CONFIG = "bcm2712_defconfig"

RPI_KERNEL_DEVICETREE_DTB = "broadcom/bcm2712-rpi-5-b.dtb"

RPI_KERNEL_DEVICETREE_OVERLAYS = " \
    overlays/overlay_map.dtb \
    overlays/ads7846.dtbo \
    overlays/disable-bt.dtbo \
    overlays/disable-wifi.dtbo \
    overlays/gpio-fan.dtbo \
    overlays/pitft28-capacitive.dtbo \
    overlays/pitft35-resistive.dtbo \
    overlays/mcp2515-can0.dtbo \
    overlays/mcp2515-can1.dtbo \
    overlays/mcp251xfd.dtbo \
    overlays/seeed-can-fd-hat-v2.dtbo \
    overlays/rpi-backlight.dtbo \
    overlays/rpi-ft5406.dtbo \
    overlays/sc16is752-spi1.dtbo \
    overlays/spi1-3cs.dtbo \
    overlays/waveshare-can-fd-hat-mode-a.dtbo \
    overlays/waveshare-can-fd-hat-mode-b.dtbo \
    overlays/vc4-fkms-v3d.dtbo \
    overlays/vc4-fkms-v3d-pi4.dtbo \
    overlays/vc4-kms-v3d.dtbo \
    overlays/vc4-kms-v3d-pi4.dtbo \
    overlays/vc4-kms-v3d-pi5.dtbo \
    overlays/vc4-kms-dsi-7inch.dtbo \
    overlays/vc4-kms-dsi-ili9881-7inch.dtbo \
    overlays/vc4-kms-dsi-ili9881-5inch.dtbo \
    overlays/w1-gpio.dtbo \
    overlays/w1-gpio-pullup.dtbo \
    overlays/w1-gpio-pi5.dtbo \
    overlays/bcm2712d0.dtbo \
"

MACHINE_FEATURES += "pci"
MACHINE_EXTRA_RRECOMMENDS += "\
    linux-firmware-rpidistro-bcm43455 \
    bluez-firmware-rpidistro-bcm4345c0-hcd \
    linux-firmware-rpidistro-bcm43456 \
    bluez-firmware-rpidistro-bcm4345c5-hcd \
"

SDIMG_KERNELIMAGE ?= "kernel_2712.img"

VC4DTBO ?= "vc4-kms-v3d"

KERNEL_IMAGETYPE = "Image"

# When u-boot is enabled we need to use the "Image" format and the "booti"
# command to load the kernel
KERNEL_IMAGETYPE_UBOOT ?= "Image"
# "zImage" not supported on arm64 and ".gz" images not supported by bootloader yet
KERNEL_IMAGETYPE_DIRECT ?= "Image"
KERNEL_BOOTCMD ?= "booti"

UBOOT_MACHINE = "rpi_arm64_config"

PREFERRED_PROVIDER_virtual/bootloader = "u-boot-venus-rpi5"

INITTAB = " \
        MA10:12345:respawn:/sbin/getty -L -l /sbin/autologin -n 115200 ttyAMA10 vt102 | \
        1:12345:respawn:/sbin/getty -L -l /sbin/autologin -n 38400 tty1 vt102 \
"

START_GUI = "start-gui"
```

## meta-bsp/conf/machine/sdk-aarch64.conf
```bitbake
require conf/machine/include/arm/armv8-2a/tune-cortexa76.inc
PREFERRED_PROVIDER_virtual/kernel ?= "linux-dummy"
PREFERRED_PROVIDER_kernel-base ?= "linux-dummy"
PREFERRED_PROVIDER_kernel-image ?= "linux-dummy"

# variable needed for compilation
MACHINE_FEATURES ?= "ext2 keyboard screen serial usbgadget usbhost"
```

## meta-bsp/conf/machine/sunxi.conf
```bitbake
SOC_FAMILY = "sunxi"
include conf/machine/include/soc-family.inc

DEFAULTTUNE = "cortexa7hf-neon-vfpv4"

require conf/machine/include/tune-cortexa7.inc

MACHINE_FEATURES = "usbhost vfat rtc serial wifi"

PACKAGECONFIG_append_pn-mesa += "kmsro lima"
PACKAGECONFIG_append_pn-qtbase += "gbm"

PREFERRED_PROVIDER_virtual/kernel = "linux-sunxi"
PREFERRED_PROVIDER_virtual/bootloader = "u-boot-sunxi"
PREFERRED_VERSION_u-boot-fw-utils = "2018.05-sunxi%"

IMAGE_FSTYPES = "ext4.gz"

FSTAB = "mmc1"

UBOOT_ENTRYPOINT = "0x40008000"
UBOOT_LOADADDRESS = "0x40008000"
UBOOT_BINARY = "u-boot-sunxi-with-spl.bin"

KERNEL_IMAGETYPE = "zImage"
KERNEL_PACKAGES = "kernel-image kernel-modules"

SDIMAGE_BOOT_FILE = "u-boot-sunxi-with-spl.bin"
SDIMAGE_BOOT_FILE_OFFS = "8"

SERIAL_CONSOLES = "-l;/sbin/autologin;-n;115200;ttyS0"
USE_VT = "0"
```
