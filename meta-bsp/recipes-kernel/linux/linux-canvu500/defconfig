## meta-bsp/recipes-kernel/linux/linux-canvu500/defconfig
```kconfig
# CONFIG_LOCALVERSION_AUTO is not set
CONFIG_KERNEL_LZO=y
CONFIG_SYSVIPC=y
CONFIG_NO_HZ=y
CONFIG_HIGH_RES_TIMERS=y
CONFIG_IKCONFIG=y
CONFIG_IKCONFIG_PROC=y
CONFIG_LOG_BUF_SHIFT=18
CONFIG_BLK_DEV_INITRD=y
# CONFIG_RD_BZIP2 is not set
# CONFIG_RD_LZMA is not set
# CONFIG_RD_XZ is not set
# CONFIG_RD_LZO is not set
# CONFIG_RD_LZ4 is not set
CONFIG_EXPERT=y
CONFIG_PERF_EVENTS=y
# CONFIG_SLUB_DEBUG is not set
# CONFIG_COMPAT_BRK is not set
CONFIG_MODULES=y
# CONFIG_BLK_DEV_BSG is not set
# CONFIG_BLK_DEBUG_FS is not set
# CONFIG_MQ_IOSCHED_DEADLINE is not set
# CONFIG_MQ_IOSCHED_KYBER is not set
CONFIG_ARCH_MXC=y
CONFIG_SOC_IMX6SX=y
CONFIG_HAVE_ARM_ARCH_TIMER=y
CONFIG_ARM_PSCI=y
CONFIG_PREEMPT_VOLUNTARY=y
CONFIG_AEABI=y
CONFIG_HIGHMEM=y
CONFIG_CMA=y
CONFIG_CMDLINE="console=ttymxc0,115200"
CONFIG_CPU_FREQ=y
CONFIG_CPU_FREQ_DEFAULT_GOV_ONDEMAND=y
CONFIG_ARM_IMX6Q_CPUFREQ=y
CONFIG_CPU_IDLE=y
CONFIG_ARM_CPUIDLE=y
CONFIG_VFP=y
CONFIG_NEON=y
CONFIG_KERNEL_MODE_NEON=y
CONFIG_NET=y
CONFIG_PACKET=y
CONFIG_PACKET_DIAG=y
CONFIG_UNIX=y
CONFIG_UNIX_DIAG=y
CONFIG_INET=y
CONFIG_IP_MULTICAST=y
CONFIG_IP_PNP=y
CONFIG_IP_PNP_DHCP=y
# CONFIG_INET_XFRM_MODE_TRANSPORT is not set
# CONFIG_INET_XFRM_MODE_TUNNEL is not set
# CONFIG_INET_XFRM_MODE_BEET is not set
CONFIG_INET_UDP_DIAG=y
CONFIG_INET_RAW_DIAG=y
# CONFIG_INET6_XFRM_MODE_TRANSPORT is not set
# CONFIG_INET6_XFRM_MODE_TUNNEL is not set
# CONFIG_INET6_XFRM_MODE_BEET is not set
# CONFIG_IPV6_SIT is not set
CONFIG_CAN=m
CONFIG_CAN_FLEXCAN=m
CONFIG_BT=m
# CONFIG_BT_DEBUGFS is not set
CONFIG_BT_HCIBTUSB=m
CONFIG_CFG80211=m
CONFIG_MAC80211=m
CONFIG_RFKILL=m
CONFIG_RFKILL_INPUT=y
CONFIG_DEVTMPFS=y
CONFIG_DEVTMPFS_MOUNT=y
# CONFIG_STANDALONE is not set
CONFIG_DMA_CMA=y
CONFIG_IMX_WEIM=y
CONFIG_MTD=y
CONFIG_MTD_CMDLINE_PARTS=y
CONFIG_MTD_BLOCK=y
CONFIG_MTD_CFI=y
CONFIG_MTD_JEDECPROBE=y
CONFIG_MTD_CFI_INTELEXT=y
CONFIG_MTD_CFI_AMDSTD=y
CONFIG_MTD_CFI_STAA=y
CONFIG_MTD_NAND_ECC_SMC=y
CONFIG_MTD_NAND=y
CONFIG_MTD_NAND_GPMI_NAND=y
CONFIG_MTD_UBI=y
CONFIG_MTD_UBI_FASTMAP=y
CONFIG_MTD_UBI_BLOCK=y
CONFIG_BLK_DEV_RAM=y
CONFIG_BLK_DEV_RAM_COUNT=1
CONFIG_EEPROM_AT24=y
CONFIG_SCSI=y
# CONFIG_SCSI_PROC_FS is not set
CONFIG_BLK_DEV_SD=y
CONFIG_SCSI_CONSTANTS=y
CONFIG_SCSI_LOGGING=y
CONFIG_SCSI_SCAN_ASYNC=y
# CONFIG_SCSI_LOWLEVEL is not set
CONFIG_NETDEVICES=y
# CONFIG_NET_CORE is not set
# CONFIG_NET_VENDOR_ALACRITECH is not set
# CONFIG_NET_VENDOR_AMAZON is not set
# CONFIG_NET_VENDOR_AQUANTIA is not set
# CONFIG_NET_VENDOR_ARC is not set
# CONFIG_NET_CADENCE is not set
# CONFIG_NET_VENDOR_BROADCOM is not set
# CONFIG_NET_VENDOR_CIRRUS is not set
# CONFIG_NET_VENDOR_EZCHIP is not set
# CONFIG_NET_VENDOR_FARADAY is not set
# CONFIG_NET_VENDOR_HISILICON is not set
# CONFIG_NET_VENDOR_INTEL is not set
# CONFIG_NET_VENDOR_MARVELL is not set
# CONFIG_NET_VENDOR_MICREL is not set
# CONFIG_NET_VENDOR_NATSEMI is not set
# CONFIG_NET_VENDOR_NETRONOME is not set
# CONFIG_NET_VENDOR_QUALCOMM is not set
# CONFIG_NET_VENDOR_RENESAS is not set
# CONFIG_NET_VENDOR_ROCKER is not set
# CONFIG_NET_VENDOR_SAMSUNG is not set
# CONFIG_NET_VENDOR_SEEQ is not set
# CONFIG_NET_VENDOR_SOLARFLARE is not set
# CONFIG_NET_VENDOR_SMSC is not set
# CONFIG_NET_VENDOR_STMICRO is not set
# CONFIG_NET_VENDOR_VIA is not set
# CONFIG_NET_VENDOR_WIZNET is not set
# CONFIG_NET_VENDOR_SYNOPSYS is not set
CONFIG_SMSC_PHY=y
# CONFIG_USB_NET_DRIVERS is not set
# CONFIG_WLAN_VENDOR_ADMTEK is not set
# CONFIG_WLAN_VENDOR_ATH is not set
# CONFIG_WLAN_VENDOR_ATMEL is not set
# CONFIG_WLAN_VENDOR_BROADCOM is not set
# CONFIG_WLAN_VENDOR_CISCO is not set
# CONFIG_WLAN_VENDOR_INTEL is not set
# CONFIG_WLAN_VENDOR_INTERSIL is not set
# CONFIG_WLAN_VENDOR_MARVELL is not set
# CONFIG_WLAN_VENDOR_MEDIATEK is not set
CONFIG_RT2X00=m
CONFIG_RT2500USB=m
CONFIG_RT73USB=m
CONFIG_RT2800USB=m
CONFIG_RT2800USB_RT3573=y
CONFIG_RT2800USB_RT53XX=y
CONFIG_RT2800USB_RT55XX=y
# CONFIG_WLAN_VENDOR_REALTEK is not set
# CONFIG_WLAN_VENDOR_RSI is not set
# CONFIG_WLAN_VENDOR_ST is not set
# CONFIG_WLAN_VENDOR_TI is not set
# CONFIG_WLAN_VENDOR_ZYDAS is not set
# CONFIG_WLAN_VENDOR_QUANTENNA is not set
CONFIG_INPUT_EVDEV=y
# CONFIG_KEYBOARD_ATKBD is not set
CONFIG_KEYBOARD_GPIO=y
# CONFIG_INPUT_MOUSE is not set
CONFIG_INPUT_TOUCHSCREEN=y
CONFIG_TOUCHSCREEN_ILI210X=y
# CONFIG_SERIO is not set
# CONFIG_LEGACY_PTYS is not set
CONFIG_SERIAL_IMX=y
CONFIG_SERIAL_IMX_CONSOLE=y
# CONFIG_HW_RANDOM is not set
# CONFIG_I2C_COMPAT is not set
CONFIG_I2C_CHARDEV=y
CONFIG_I2C_MUX=y
# CONFIG_I2C_HELPER_AUTO is not set
CONFIG_I2C_IMX=y
CONFIG_PPS=y
# CONFIG_PTP_1588_CLOCK is not set
CONFIG_GPIO_SYSFS=y
CONFIG_POWER_RESET=y
CONFIG_POWER_RESET_IMX=y
CONFIG_POWER_SUPPLY=y
# CONFIG_HWMON is not set
CONFIG_THERMAL=y
CONFIG_CPU_THERMAL=y
CONFIG_IMX_THERMAL=y
CONFIG_WATCHDOG=y
CONFIG_IMX2_WDT=y
CONFIG_REGULATOR=y
CONFIG_REGULATOR_FIXED_VOLTAGE=y
CONFIG_REGULATOR_ANATOP=y
CONFIG_REGULATOR_GPIO=y
CONFIG_DRM=y
CONFIG_DRM_PANEL_SIMPLE=y
CONFIG_DRM_ETNAVIV=y
CONFIG_DRM_MXSFB=y
CONFIG_BACKLIGHT_LCD_SUPPORT=y
# CONFIG_LCD_CLASS_DEVICE is not set
CONFIG_BACKLIGHT_CLASS_DEVICE=y
# CONFIG_BACKLIGHT_GENERIC is not set
CONFIG_BACKLIGHT_PWM=y
CONFIG_FRAMEBUFFER_CONSOLE=y
CONFIG_USB=y
# CONFIG_USB_DEFAULT_PERSIST is not set
CONFIG_USB_EHCI_HCD=y
CONFIG_USB_EHCI_MXC=y
CONFIG_USB_STORAGE=y
CONFIG_USB_CHIPIDEA=y
CONFIG_USB_CHIPIDEA_HOST=y
CONFIG_NOP_USB_XCEIV=y
CONFIG_USB_MXS_PHY=y
CONFIG_MMC=y
CONFIG_MMC_SDHCI=y
CONFIG_MMC_SDHCI_PLTFM=y
CONFIG_MMC_SDHCI_ESDHC_IMX=y
CONFIG_RTC_CLASS=y
# CONFIG_RTC_NVMEM is not set
CONFIG_RTC_INTF_DEV_UIE_EMUL=y
CONFIG_RTC_DRV_SNVS=y
CONFIG_DMADEVICES=y
CONFIG_IMX_SDMA=y
CONFIG_MXS_DMA=y
# CONFIG_MX3_IPU is not set
CONFIG_IIO=y
CONFIG_VF610_ADC=y
CONFIG_MPL3115=y
CONFIG_PWM=y
CONFIG_PWM_IMX=y
CONFIG_NVMEM_IMX_IIM=y
CONFIG_NVMEM_IMX_OCOTP=y
CONFIG_EXT4_FS=y
CONFIG_EXT4_FS_POSIX_ACL=y
CONFIG_EXT4_FS_SECURITY=y
CONFIG_VFAT_FS=y
CONFIG_CONFIGFS_FS=y
CONFIG_UBIFS_FS=y
# CONFIG_NETWORK_FILESYSTEMS is not set
CONFIG_NLS_DEFAULT="cp437"
CONFIG_NLS_CODEPAGE_437=y
CONFIG_NLS_ASCII=y
CONFIG_NLS_ISO8859_1=y
CONFIG_NLS_ISO8859_15=y
CONFIG_NLS_UTF8=y
CONFIG_PRINTK_TIME=y
CONFIG_DEBUG_FS=y
CONFIG_MAGIC_SYSRQ=y
# CONFIG_SCHED_DEBUG is not set
CONFIG_PROVE_LOCKING=y
# CONFIG_FTRACE is not set
# CONFIG_ARM_UNWIND is not set
CONFIG_DEBUG_LL=y
CONFIG_EARLY_PRINTK=y
CONFIG_CRYPTO_SEQIV=y
# CONFIG_CRYPTO_ECHAINIV is not set
# CONFIG_CRYPTO_HW is not set
```

## meta-third-party/conf/layer.conf
```bitbake
BBPATH := "${BBPATH}:${LAYERDIR}"

BBFILES := "${BBFILES} \
	${LAYERDIR}/recipes-*/*.bb \
	${LAYERDIR}/recipes-*/*/*.bb \
	${LAYERDIR}/recipes-*/*/*/*.bb \
"

BBFILE_COLLECTIONS += "victronenergy-third-party"
BBFILE_PATTERN_victronenergy-third-party := "^${LAYERDIR}/"
BBFILE_PRIORITY_victronenergy-third-party = "5"
LAYERSERIES_COMPAT_victronenergy-third-party = "rocko thud zeus"
```

## meta-ve-software/conf/layer.conf
```bitbake
BBPATH := "${BBPATH}:${LAYERDIR}"

BBFILES := "${BBFILES} \
    ${LAYERDIR}/recipes-*/*.bb \
    ${LAYERDIR}/recipes-*/*/*.bb \
    ${LAYERDIR}/recipes-*/*/*/*.bb \
"

BBFILE_COLLECTIONS += "victronenergy-software"
BBFILE_PATTERN_victronenergy-software := "^${LAYERDIR}/"
BBFILE_PRIORITY_victronenergy-software = "5"
LAYERSERIES_COMPAT_victronenergy-software = "scarthgap"

ERROR_QA:remove:layer-victronenergy-software = "patch-status"

LICENSE_PATH += "${LAYERDIR}/licenses"
```

## meta-venus/conf/distro/venus.conf
```bitbake
DISTRO = "venus"
DISTRO_NAME = "Victron Energy"
DISTRO_VERSION = "v3.70~35"
SDK_VENDOR = "-ve"
SDK_VERSION := "${DISTRO_VERSION}"

MAINTAINER = "Jeroen Hofstee <jhofstee@victronenergy.com>"

TARGET_VENDOR = "-ve"

LOCALCONF_VERSION = "1"
LAYER_CONF_VERSION ?= "6"

INHERIT:remove = "create-spdx"

DISTRO_FEATURES = " \
    bluetooth \
    bluez5 \
    fbdev \
    gles2 \
    ipv4 \
    ipv6 \
    opengl \
    sysvinit \
    usbhost \
    usbgadget \
    wayland \
    wifi \
    ${DISTRO_FEATURES_LIBC} \
"

# See backfilling, this gets enabled by default unless unset
DISTRO_FEATURES_BACKFILL_CONSIDERED = "pulseaudio"

USERADDEXTENSION = "useradd-staticids"
USERADD_ERROR_DYNAMIC = "error"

BAD_RECOMMENDATIONS = "rng-tools"

ROOTFS_RO_UNNEEDED = "${ROOTFS_BOOTSTRAP_INSTALL}"
IMAGE_NAME_SUFFIX = ""

COREVERSION = "${@d.getVar('LAYERSERIES_CORENAMES').split()[0]}"
SDK_NAME = "${DISTRO}-${COREVERSION}-${SDK_ARCH}-${TARGET_ARCH}-${DEFAULTTUNE}"
SDKPATHINSTALL := "/opt/${DISTRO}/${COREVERSION}-${TARGET_ARCH}-${DEFAULTTUNE}"

OLDEST_KERNEL = "5.10"
PREFERRED_PROVIDER_make = "make"
PREFERRED_PROVIDER_make-native = "make-native"
PREFERRED_VERSION_swupdate = "2016.10"
PREFERRED_PROVIDER_u-boot-fw-utils = "u-boot-fw-utils"

PREFERRED_VERSION_python3-pymodbus = "2.5.3"

# The gui to start, a machine can override this.
START_GUI ?= "start-gui-v1"

SWU_VERSION ?= "1"
SWU ?= "venus-swu${@d.getVar('SWU_VERSION') > '1' and '-' + d.getVar('SWU_VERSION') or ''}"

VOLATILE_LOG_DIR = "no"

# Recommended settings per https://wiki.mozilla.org/Security/Server_Side_TLS
OPENSSL_CIPHERSTRING = " \
    ECDHE-ECDSA-AES128-GCM-SHA256 \
    ECDHE-RSA-AES128-GCM-SHA256 \
    ECDHE-ECDSA-AES256-GCM-SHA384 \
    ECDHE-RSA-AES256-GCM-SHA384 \
    ECDHE-ECDSA-CHACHA20-POLY1305 \
    ECDHE-RSA-CHACHA20-POLY1305 \
    DHE-RSA-AES128-GCM-SHA256 \
    DHE-RSA-AES256-GCM-SHA384 \
    DHE-RSA-CHACHA20-POLY1305 \
"
OPENSSL_CIPHERSTRING_COLONS := "${@':'.join(d.getVar('OPENSSL_CIPHERSTRING').split())}"

OPENSSL_CIPHERSUITES = " \
    TLS_AES_128_GCM_SHA256 \
    TLS_AES_256_GCM_SHA384 \
    TLS_CHACHA20_POLY1305_SHA256 \
"
OPENSSL_CIPHERSUITES_COLONS := "${@':'.join(d.getVar('OPENSSL_CIPHERSUITES').split())}"

# Move opkg data out of /var/lib since it will become and overlayfs with a readonly rootfs.
# See also opkg_%.bbappend.
OPKGLIBDIR = "${libdir}"

#PREMIRRORS ?=
#MIRRORS =+ ""

INHERIT += "venus-checks venus-ipk-info"

# The CONNECTIVITY_CHECK_URI's are used to test whether we can succesfully
# fetch from the network (and warn you if not). To disable the test set
# the variable to be empty.
# Git example url: git://git.yoctoproject.org/yocto-firewall-test;protocol=git;rev=HEAD

CONNECTIVITY_CHECK_URIS ?= ""

SANITY_TESTED_DISTROS ?= " \
    ubuntu-20.04 \n \
    ubuntu-22.04 \n \
    ubuntu-24.04 \n \
"

# Default hash policy for distro
BB_SIGNATURE_HANDLER ?= 'OEBasicHash'

UNPACKDIR ?= "${WORKDIR}"

# S cannot point to UNPACKDIR in scartgap since it is WORKDIR, it is fine to not
# exist though in scarthgap. In newer version it must be UNPACKDIR or below and
# must exist. So just use S = "${S_UNUSED}", so sed can handle it.
S_UNUSED = "${WORKDIR}/temp"
```

## meta-venus/conf/layer.conf
```bitbake
BBPATH := "${BBPATH}:${LAYERDIR}"

BBFILES := "${BBFILES} \
    ${LAYERDIR}/recipes-*/*.bb \
    ${LAYERDIR}/recipes-*/*/*.bb \
    ${LAYERDIR}/recipes-*/*.bbappend \
    ${LAYERDIR}/recipes-*/*/*.bbappend \
"

BBFILE_COLLECTIONS += "victronenergy-venus"
BBFILE_PATTERN_victronenergy-venus := "^${LAYERDIR}/"
BBFILE_PRIORITY_victronenergy-venus = "7"

LAYERSERIES_COMPAT_victronenergy-venus = "scarthgap"

ERROR_QA:remove:layer-victronenergy-venus = "patch-status"

# newer go version are backported to kirkstone, which is actually older
# than scartgap. So mark scarthgap as compatible as well. It will be
# branched of if required.
LAYERSERIES_COMPAT_lts-go-mixin += "scarthgap"
```

## meta-venus/recipes-images/venus-image.beaglebone.wks
```
# short-description: Create SD card image with a boot partition
# long-description: Creates a partitioned SD card image. Boot files
# are located in the first vfat partition.

part /boot --source bootimg-partition --ondisk mmcblk0 --fstype=vfat --label boot --active --align 4 --size 16
part / --source rootfs --ondisk mmcblk0 --fstype=ext4 --label root --align 4
part /data --ondisk mmcblk0 --size 100M --fstype=ext4 --label data --align 4
```

## meta-venus/recipes-support/swupdate/files/canvu500/defconfig
```kconfig
# CONFIG_LUA is not set
CONFIG_DOWNLOAD=y
CONFIG_UBIVOL=y
CONFIG_CFI=y
CONFIG_RAW=y
CONFIG_PIPE=y
CONFIG_SHELLSCRIPTHANDLER=y
CONFIG_UBOOT=y
```

## meta-venus/wic/sdimage-raspberrypi.wks
```
part /recover --source rawcopy --sourceparams file=recover-partition.vfat --ondisk mmcblk0 --fstype=vfat --label recover --active --align 4096 --size 100
part /boot1 --source bootimg-partition --ondisk mmcblk0 --fstype=vfat --label boot1 --active --align 4096 --size 100
part /boot2 --source bootimg-partition --ondisk mmcblk0 --fstype=vfat --label boot2 --active --align 4096 --size 100
part / --source rootfs --ondisk mmcblk0 --fstype=ext4 --label root --align 4096 --overhead-factor=1 --extra-space 0 --size 1 --type logical
```
